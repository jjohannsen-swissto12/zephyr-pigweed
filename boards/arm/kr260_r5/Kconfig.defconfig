## boards/arm/kr260_r5/Kconfig.defconfig
```kconfig
# Copyright (c) 2022 Linaro.
# SPDX-License-Identifier: Apache-2.0

if BOARD_KR260_R5

config BUILD_OUTPUT_BIN
	default y

config BOARD
	default "board_kr260_r5"

if USERSPACE

config COMPILER_ISA_THUMB2
	default n

endif

endif # BOARD_KR260_R5
```

## drivers/led/pwmled/Kconfig
```kconfig
menuconfig PWMLED
    bool "Custom PWMLED IP driver"
    help
      Enable AXI Lite-based PWMLED IP driver.
```

## manifest/west.yml
```yaml
# Copyright (c) 2024 Google LLC
# SPDX-License-Identifier: Apache-2.0

manifest:
  projects:
  - import: false
    name: pigweed
    path: third_party/pigweed
    remote: pigweed
    revision: 5477cb202c57ede4bf9981f4ab067abec1bdb6cf
  - import: true
    name: zephyr
    path: third_party/pigweed/environment/packages/zephyr
    remote: zephyr
    revision: f9778472105d756fff7d1e5b54353421d356ed43
  remotes:
  - name: pigweed
    url-base: git@github.com:google/pigweed.git
  - name: zephyr
    url-base: https://pigweed.googlesource.com/third_party/github/zephyrproject-rtos/zephyr
```
