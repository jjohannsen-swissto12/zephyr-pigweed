/*
 * Copyright (c) 2022 Linaro.
 *
 * SPDX-License-Identifier: Apache-2.0
 *
 */

/dts-v1/;
#include <arm/xilinx/zynqmp_rpu.dtsi>

/ {
	model = "KR260 Cortex-R5";
	compatible = "xlnx,zynqmp-r5";

	chosen {
		zephyr,sram = &sram0;
		zephyr,flash = &flash0;
		zephyr,console = &uart1;
		zephyr,shell-uart = &uart1;
		zephyr,ocm = &ocm;
	};
};

&uart1 {
	status = "okay";
	current-speed = <115200>;
	clock-frequency = <99999901>;
};

&ttc0 {
	status = "okay";
	clock-frequency = <5000000>;
};

&psgpio {
	status = "okay";
};

### --- From here on down ↓

leds {
        compatible = "gpio-leds";
        led_0: led_0 {
                gpios = <&gpio1 1 GPIO_ACTIVE_HIGH>;
        };
};

gpio1: gpio@80010000 {
    compatible = "xlnx,ps-gpio";
    status = "okay";
    reg = <0x80010000 0x1000>;
    interrupts = <GIC_SPI 16 IRQ_TYPE_LEVEL
            IRQ_DEFAULT_PRIORITY>;
    interrupt-names = "irq_0";

    #address-cells = <1>;
    #size-cells = <0>;

#    psgpio_bank0: psgpio_bank@0 {
#        compatible = "xlnx,ps-gpio-bank";
#        reg = <0x0>;
#        gpio-controller;
#        #gpio-cells = <2>;
#        ngpios = <26>;
#        status = "okay";
#    };
};
