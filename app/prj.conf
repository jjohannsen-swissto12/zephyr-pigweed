## prj.conf
```kconfig
# Copyright (c) 2024 Google LLC
# SPDX-License-Identifier: Apache-2.0

# C++ configs
CONFIG_CPP=y
CONFIG_STD_CPP17=y
CONFIG_REQUIRES_FULL_LIBCPP=y

# Logging
CONFIG_LOG=y
CONFIG_PIGWEED_THREAD_SLEEP=y
#CONFIG_PIGWEED_LOG_TOKENIZED=y

CONFIG_PWMLED=y
```

## src/main.cc
```c
/* Copyright (c) 2024 Google LLC
 * SPDX-License-Identifier: Apache-2.0
 */

#define PW_LOG_MODULE_NAME "codelab"

#include "hello.h"
#include "pw_log/log.h"
#include <pwmled.h>

int main() {
	pw::StringBuffer<128> buffer;
	pw::InlineString<6> greeting = "Hello";
	pw::InlineString<6> name = "World";
	app::WelcomeMessage( buffer, greeting, name );
	PW_LOG_INFO( "%s", buffer.c_str() );

	// Get the device
	auto device = device_get_binding( "pwmled0" );
	if ( device == NULL ) {
		LOG_ERR( "Failed to get PWMLED device binding\n" );
		return 0;
	}

	LOG_INF( "device is %p, name is %s", device, device->name );

	pwmled_set_value( device, 2 );

	return 0;
}
```

## src/test_main.cc
```c
/* Copyright (c) 2024 Google LLC
 * SPDX-License-Identifier: Apache-2.0
 */

#include "pw_unit_test/framework.h"
#include "pw_unit_test/logging_event_handler.h"

int main( int argc, char **argv ) {
	testing::InitGoogleTest( &argc, argv );
	pw::unit_test::LoggingEventHandler handler;
	pw::unit_test::RegisterEventHandler( &handler );
	return RUN_ALL_TESTS();
}
```
